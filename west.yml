## west.yml
```yaml
manifest:
  # lowest version of the manifest file schema that can parse this file’s data
  version: 0.8

  projects:
    - name: zephyr
      url: https://github.com/zephyrproject-rtos/zephyr
      revision: v3.4.0
      west-commands: scripts/west-commands.yml
      import:
        path-prefix: deps
        name-allowlist:
          - cmsis
          - hal_nordic
          - nrfxlib

  # Settings applied using the self key will only be applied to the manifest repository
  self:
  path: app_eric
```
